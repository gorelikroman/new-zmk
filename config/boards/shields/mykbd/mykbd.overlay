/ {
    chosen {
        zmk,kscan = &kscan0;
    };

    kscan0: kscan0 {
        compatible = "zmk,kscan-gpio-direct";
        wakeup-source;

        /*
         * TEST PINS (CHANGE LATER):
         * Assumes each switch connects GPIO -> GND
         * so we use ACTIVE_LOW + PULL_UP.
         *
         * Replace with the GPIOs you actually wired.
         */
        input-gpios = <
    &gpio0 2  (GPIO_ACTIVE_LOW | GPIO_PULL_UP)
    &gpio0 6  (GPIO_ACTIVE_LOW | GPIO_PULL_UP)
    &gpio0 8  (GPIO_ACTIVE_LOW | GPIO_PULL_UP)
    &gpio0 17 (GPIO_ACTIVE_LOW | GPIO_PULL_UP)
>;
        >;
    };
};
